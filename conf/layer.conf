## conf/layer.conf
```bitbake
# We have a conf and classes directory, add to BBPATH
BBPATH .= ":${LAYERDIR}"

# We have recipes-* directories, add to BBFILES
BBFILES += "${LAYERDIR}/recipes-*/*/*.bb \
            ${LAYERDIR}/recipes-*/*/*.bbappend"

BBFILE_COLLECTIONS += "meta-midihost"
BBFILE_PATTERN_meta-midihost = "^${LAYERDIR}/"
BBFILE_PRIORITY_meta-midihost = "6"

LAYERDEPENDS_meta-midihost = "core"
LAYERSERIES_COMPAT_meta-midihost = "dunfell"
```
